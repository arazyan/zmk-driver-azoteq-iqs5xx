## drivers/input/Kconfig
```kconfig
menuconfig INPUT_AZOTEQ_IQS5XX
    bool "Azoteq IQS5xx trackpads"
    default y
    depends on GPIO
    depends on I2C
    depends on INPUT
    depends on DT_HAS_AZOTEQ_IQS5XX_ENABLED
    help
      Enable driver for Azoteq IQS5xx trackpads.

if INPUT_AZOTEQ_IQS5XX

config INPUT_AZOTEQ_IQS5XX_INIT_PRIORITY
    int "Azoteq IQS5xx initialization priority"
    default INPUT_INIT_PRIORITY
    help
      Driver initialization priority for the IQS5xx driver.
      Lower values initialize earlier.

config INPUT_AZOTEQ_IQS5XX_POLL_INTERVAL_MS
    int "I2C polling interval in milliseconds"
    default 16
    help
      Polling interval used when no RDY GPIO is configured in the
      devicetree. The Ergo Haven K:04 touchpad module socket does not
      route the trackpad's RDY line to the MCU, so the chip must be
      polled. 16ms gives ~60 reports/s; lower for smoother motion at
      the cost of some battery drain on the peripheral half.

config INPUT_AZOTEQ_IQS5XX_POLL_BACKOFF_MS
    int "I2C polling interval in milliseconds while the chip is unresponsive"
    default 1000
    help
      When a full read cycle fails (no module in the socket, dead bus)
      the poll loop slows to this interval instead of hammering the bus
      at full speed. The loop returns to POLL_INTERVAL_MS as soon as a
      read succeeds again.

endif # INPUT_AZOTEQ_IQS5XX
```
